## meta-opennow/conf/layer.conf
```bitbake
BBPATH .= ":${LAYERDIR}"
BBFILES += "${LAYERDIR}/recipes-*/*/*.bb"

BBFILE_COLLECTIONS += "opennow"
BBFILE_PATTERN_opennow = "^${LAYERDIR}/"
BBFILE_PRIORITY_opennow = "6"
LAYERVERSION_opennow = "1"
LAYERDEPENDS_opennow = "core openembedded-layer meta-python qt6-layer"
LAYERSERIES_COMPAT_opennow = "wrynose"
```
